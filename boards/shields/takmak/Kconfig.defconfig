## boards/shields/takmak/Kconfig.defconfig
```kconfig
if SHIELD_TAKMAK_LEFT

if LVGL

config LV_Z_VDB_SIZE
    default 64

config LV_DPI_DEF
    default 148

config LV_Z_BITS_PER_PIXEL
    default 1

choice LV_COLOR_DEPTH
    default LV_COLOR_DEPTH_1
endchoice

endif # LVGL

if ZMK_DISPLAY

config I2C
    default y

config SSD1306
    default y

endif # ZMK_DISPLAY

endif # end SHIELD_TAKMAK_LEFT


if SHIELD_TAKMAK_LEFT || SHIELD_TAKMAK_RIGHT || SHIELD_TAKMAK_DONGLE

config ZMK_SPLIT
    default y

endif # end both
```

## config/dts/bindings/dummy-led-strip.yaml
```yaml
description: Dummy LED strip for testing

compatible: "dummy,led-strip"

properties:
  chain-length:
    type: int
    required: true
    description: Number of LEDs in strip

  color-mapping:
    type: array
    required: true
    description: Color channel mapping

  "#led-cells":
    type: int
    const: 3
    description: Number of cells in LED specifier

  "#binding-cells":
    type: int
    const: 0
```

## config/west.yml
```yaml
manifest:
  remotes:
    - name: zmkfirmware
      url-base: https://github.com/zmkfirmware
    - name: seniorsoftwarevlogger
      url-base: https://github.com/seniorsoftwarevlogger
  projects:
    - name: zmk
      remote: zmkfirmware
      revision: 147c340c6e8d377304acfdd64dc86cf83ebdfef2 # (see important notice in Installation Guide in the dongle-screen readme)
      import: app/west.yml
    - name: zmk-dongle-screen
      remote: seniorsoftwarevlogger
      revision: cea154a53e3f791d769666aebd719cbe4a479391
  self:
    path: config
```
